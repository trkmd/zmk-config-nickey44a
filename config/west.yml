## config/west.yml
```yaml
manifest:
  remotes:
    - name: zmkfirmware
      url-base: https://github.com/zmkfirmware
    - name: cormoran
      url-base: https://github.com/cormoran
    - name: caksoylar  # <-- RGB LED
      url-base: https://github.com/caksoylar
  projects:
    - name: zmk
      remote: cormoran
      revision: v0.3-branch+dya
      import: app/west.yml
    - name: zmk-rgbled-widget
      remote: caksoylar
      revision: 8756cb7b8114069fa3c25c6f6c990f24988fceff # v0.3
    - name: zmk-feature-runtime-combo
      remote: cormoran
      revision: b067f7c2c3
      import: true
    - name: zmk-feature-custom-settings
      remote: cormoran
      revision: 727cd4578a
  self:
    path: config
```
